## artifacts/m5_build/ipq5018-cr8818.its
```
/dts-v1/;

/ {
	description = "ARM64 OpenWrt FIT (Flattened Image Tree)";
	#address-cells = <1>;

	images {
		kernel-1 {
			description = "ARM64 OpenWrt Linux-6.12.112";
			data = /incbin/("/mnt/d/vibecode/CR8808-CUSTOM-FIRMWARE/artifacts/m5_build/Image.gz");
			type = "kernel";
			arch = "arm64";
			os = "linux";
			compression = "gzip";
			load = <0x44000000>;
			entry = <0x44000000>;
			hash-1 {
				algo = "crc32";
			};
			hash-2 {
				algo = "sha1";
			};
		};


		fdt-1 {
			description = "ARM64 OpenWrt Xiaomi CR8818 device tree blob";
			
			data = /incbin/("/mnt/d/vibecode/CR8808-CUSTOM-FIRMWARE/artifacts/m5_build/ipq5018-xiaomi-cr8818-daily.dtb");
			type = "flat_dt";
			
			arch = "arm64";
			compression = "none";
			hash-1 {
				algo = "crc32";
			};
			hash-2 {
				algo = "sha1";
			};
		};



	};

	configurations {
		default = "config-1";
		config-1 {
			description = "OpenWrt Xiaomi CR8818";
			kernel = "kernel-1";
			fdt = "fdt-1";
			
			
			
		};
		
	};
};
```
